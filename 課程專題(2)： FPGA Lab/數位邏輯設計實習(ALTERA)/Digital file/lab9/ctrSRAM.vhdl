-- generated by Digital. Don't modify this file!
-- Any changes will be lost if this file is regenerated.

LIBRARY ieee;
USE ieee.std_logic_1164.all;

entity FSM is
    port (
        clk  : in  std_logic;
        rst  : in  std_logic;
        sel1 : out std_logic;
        en1  : out std_logic;
        sel2 : out std_logic;
        en2  : out std_logic;
        Addr : out std_logic_vector(1 downto 0);
        CS   : out std_logic;
        WE   : out std_logic;
        OE   : out std_logic
    );
end FSM;

architecture FSM_arch of FSM is
    type state_type is (S0, S1, S2, S3, S4, S5);
    signal current_state, next_state : state_type;
begin

    -- ==========================================
    -- ???????? reset?
    -- ==========================================
    process(clk)
    begin
        if rising_edge(clk) then
            if rst = '1' then
                current_state <= S0;   -- ?? reset ? S0
            else
                current_state <= next_state;
            end if;
        end if;
    end process;

    -- ==========================================
    -- ?????rst ??????S0 ? rst ???
    -- ==========================================
    process(current_state, rst)
    begin
        case current_state is
            when S0 =>
                if rst = '1' then
                    next_state <= S0;   -- rst ???? S0
                else
                    next_state <= S1;   -- rst ?????
                end if;
            when S1 => next_state <= S2;
            when S2 => next_state <= S3;
            when S3 => next_state <= S4;
            when S4 => next_state <= S5;
            when S5 => next_state <= S5;
            when others => next_state <= S0;
        end case;
    end process;

    -- ==========================================
    -- ?????Moore?
    -- ==========================================
    process(current_state)
    begin
        sel1 <= '0'; en1 <= '0'; sel2 <= '0'; en2 <= '0';
        Addr <= "00"; CS <= '0'; WE <= '0'; OE <= '0';

        case current_state is
            when S0 =>
                sel1 <= '0'; en1 <= '0'; sel2 <= '0'; en2 <= '0';
                Addr <= "00"; CS <= '0'; WE <= '0'; OE <= '0';
            when S1 =>
                sel1 <= '0'; en1 <= '0'; sel2 <= '0'; en2 <= '0';
                Addr <= "00"; CS <= '1'; WE <= '1'; OE <= '0';
            when S2 =>
                sel1 <= '0'; en1 <= '0'; sel2 <= '0'; en2 <= '0';
                Addr <= "01"; CS <= '1'; WE <= '1'; OE <= '0';
            when S3 =>
                sel1 <= '0'; en1 <= '1'; sel2 <= '0'; en2 <= '0';
                Addr <= "00"; CS <= '1'; WE <= '0'; OE <= '1';
            when S4 =>
                sel1 <= '1'; en1 <= '0'; sel2 <= '1'; en2 <= '1';
                Addr <= "01"; CS <= '1'; WE <= '0'; OE <= '1';
            when S5 =>
                sel1 <= '1'; en1 <= '0'; sel2 <= '1'; en2 <= '1';
                Addr <= "01"; CS <= '1'; WE <= '1'; OE <= '1';
            when others =>
                null;
        end case;
    end process;

end FSM_arch;


LIBRARY ieee;
USE ieee.std_logic_1164.all;
USE ieee.numeric_std.all;

entity SRAM is
port (	
    D: in std_logic_vector(3 downto 0);
    Address: in std_logic_vector(1 downto 0);
    ChipSelect, WE, OE: in std_logic;
    DO: out std_logic_vector(3 downto 0)
);
end SRAM;

architecture SRAM_simple of SRAM is
    type memory is array (0 to 3) of std_logic_vector(3 downto 0);
    signal SRAM_internal: memory := (others => "0000");
begin
    -- ?????CS=1 ? WE=1 ?????? OE ???
    process(ChipSelect, WE, Address, D)
    begin
        if (ChipSelect = '1' and WE = '1') then
            SRAM_internal(to_integer(unsigned(Address))) <= D;
        end if;
    end process;

    -- ?????CS=1 ? OE=1 ????WE=1 ?????????? write-through?
    DO <= SRAM_internal(to_integer(unsigned(Address)))
          when (ChipSelect = '1' and OE = '1')
          else "ZZZZ";
end SRAM_simple;


LIBRARY ieee;
USE ieee.std_logic_1164.all;

entity MUX_GATE_BUS_1 is
  generic ( Bits : integer ); 
  port (
    p_out: out std_logic_vector ((Bits-1) downto 0);
    sel: in std_logic;
    
    in_0: in std_logic_vector ((Bits-1) downto 0);
    in_1: in std_logic_vector ((Bits-1) downto 0) );
end MUX_GATE_BUS_1;

architecture Behavioral of MUX_GATE_BUS_1 is
begin
  with sel select
    p_out <=
      in_0 when '0',
      in_1 when '1',
      (others => '0') when others;
end Behavioral;


LIBRARY ieee;
USE ieee.std_logic_1164.all;

entity DIG_Register_BUS is
  generic ( Bits: integer ); 
  port (
    Q: out std_logic_vector ((Bits-1) downto 0);
    D: in std_logic_vector ((Bits-1) downto 0);
    C: in std_logic;
    en: in std_logic );
end DIG_Register_BUS;

architecture Behavioral of DIG_Register_BUS is
  signal state : std_logic_vector ((Bits-1) downto 0) := (others => '0');
begin
   Q <= state;

   process ( C )
   begin
      if rising_edge(C) and (en='1') then
        state <= D;
      end if;
   end process;
end Behavioral;


LIBRARY ieee;
USE ieee.std_logic_1164.all;
USE ieee.numeric_std.all;

entity DEMUX_GATE_BUS_1 is
  generic (
    Bits : integer;
    Default : integer );
  port (
    out_0: out std_logic_vector ((Bits-1) downto 0);
    out_1: out std_logic_vector ((Bits-1) downto 0);
    sel: in std_logic;
    p_in: in std_logic_vector ((Bits-1) downto 0) );
end DEMUX_GATE_BUS_1;

architecture Behavioral of DEMUX_GATE_BUS_1 is
begin
    out_0 <= p_in when sel = '0' else std_logic_vector(to_unsigned(Default, Bits));
    out_1 <= p_in when sel = '1' else std_logic_vector(to_unsigned(Default, Bits));
end Behavioral;


LIBRARY ieee;
USE ieee.std_logic_1164.all;
USE ieee.numeric_std.all;

entity n1bit_fulladder is
  port (
    A: in std_logic;
    B: in std_logic;
    Cin: in std_logic;
    Cout: out std_logic;
    Sum: out std_logic);
end n1bit_fulladder;

architecture Behavioral of n1bit_fulladder is
  signal s0: std_logic;
  signal s1: std_logic;
  signal s2: std_logic;
begin
  s0 <= NOT A;
  s1 <= NOT B;
  s2 <= NOT Cin;
  Sum <= (A XOR B XOR Cin);
  Cout <= ((A AND B) OR (A AND Cin) OR (B AND Cin));
end Behavioral;

LIBRARY ieee;
USE ieee.std_logic_1164.all;
USE ieee.numeric_std.all;

entity n4bit_adder_subtractor is
  port (
    C: in std_logic;
    B: in std_logic_vector(3 downto 0);
    A: in std_logic_vector(3 downto 0);
    Co: out std_logic;
    S: out std_logic_vector(3 downto 0));
end n4bit_adder_subtractor;

architecture Behavioral of n4bit_adder_subtractor is
  signal s0: std_logic;
  signal s1: std_logic;
  signal s2: std_logic;
  signal s3: std_logic;
  signal s4: std_logic;
  signal s5: std_logic;
  signal s6: std_logic;
  signal s7: std_logic;
  signal s8: std_logic;
  signal s9: std_logic;
  signal s10: std_logic;
  signal s11: std_logic;
  signal s12: std_logic;
  signal s13: std_logic;
  signal s14: std_logic;
begin
  s1 <= (B(0) XOR C);
  s5 <= (B(1) XOR C);
  s9 <= (B(2) XOR C);
  s13 <= (B(3) XOR C);
  s0 <= A(0);
  s4 <= A(1);
  s8 <= A(2);
  s12 <= A(3);
  gate0: entity work.n1bit_fulladder
    port map (
      A => s0,
      B => s1,
      Cin => C,
      Cout => s2,
      Sum => s3);
  gate1: entity work.n1bit_fulladder
    port map (
      A => s4,
      B => s5,
      Cin => s2,
      Cout => s6,
      Sum => s7);
  gate2: entity work.n1bit_fulladder
    port map (
      A => s8,
      B => s9,
      Cin => s6,
      Cout => s10,
      Sum => s11);
  gate3: entity work.n1bit_fulladder
    port map (
      A => s12,
      B => s13,
      Cin => s10,
      Cout => Co,
      Sum => s14);
  S(0) <= s3;
  S(1) <= s7;
  S(2) <= s11;
  S(3) <= s14;
end Behavioral;

LIBRARY ieee;
USE ieee.std_logic_1164.all;
USE ieee.numeric_std.all;

entity main is
  port (
    D: in std_logic_vector(3 downto 0);
    rst: in std_logic;
    clk: in std_logic;
    S3: out std_logic_vector(1 downto 0);
    S2: out std_logic;
    S1: out std_logic;
    S0: out std_logic);
end main;

architecture Behavioral of main is
  signal s4: std_logic_vector(3 downto 0);
  signal S3_temp: std_logic_vector(1 downto 0);
  signal S2_temp: std_logic;
  signal S1_temp: std_logic;
  signal S0_temp: std_logic;
  signal s5: std_logic_vector(3 downto 0);
  signal s6: std_logic;
  signal s7: std_logic_vector(3 downto 0);
  signal s8: std_logic_vector(3 downto 0);
  signal s9: std_logic;
  signal s10: std_logic_vector(3 downto 0);
  signal s11: std_logic_vector(3 downto 0);
  signal s12: std_logic;
  signal s13: std_logic_vector(3 downto 0);
  signal s14: std_logic;
begin
  gate0: entity work.FSM -- FSM
    port map (
      clk => clk,
      rst => rst,
      sel1 => s12,
      en1 => s14,
      sel2 => s6,
      en2 => s9,
      Addr => S3_temp,
      CS => S2_temp,
      WE => S1_temp,
      OE => S0_temp);
  gate1: entity work.SRAM -- SRAM
    port map (
      D => s4,
      Address => S3_temp,
      ChipSelect => S2_temp,
      WE => S1_temp,
      OE => S0_temp,
      DO => s5);
  gate2: entity work.MUX_GATE_BUS_1
    generic map (
      Bits => 4)
    port map (
      sel => s6,
      in_0 => D,
      in_1 => s7,
      p_out => s4);
  gate3: entity work.DIG_Register_BUS
    generic map (
      Bits => 4)
    port map (
      D => s8,
      C => clk,
      en => s9,
      Q => s7);
  gate4: entity work.DEMUX_GATE_BUS_1
    generic map (
      Bits => 4,
      Default => 0)
    port map (
      sel => s12,
      p_in => s5,
      out_0 => s13,
      out_1 => s10);
  gate5: entity work.DIG_Register_BUS
    generic map (
      Bits => 4)
    port map (
      D => s13,
      C => clk,
      en => s14,
      Q => s11);
  gate6: entity work.n4bit_adder_subtractor
    port map (
      C => '0',
      B => s10,
      A => s11,
      S => s8);
  S3 <= S3_temp;
  S2 <= S2_temp;
  S1 <= S1_temp;
  S0 <= S0_temp;
end Behavioral;
